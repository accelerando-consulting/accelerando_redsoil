## zephyr/boards/arm/accelerando-redsoil/Kconfig.board
```kconfig
# Accelerando Redsoil (Breakout for eByte E73-2G4M08S1C nrf52840 System-on-module) configuration
config BOARD_ACCLERANDO_REDSOIL
	bool "Accelerando Redsoil with eByte E73-2G4M08S1C nrf52840 System-on-module"
	depends on SOC_NRF52840_QIAA
```

## zephyr/boards/arm/accelerando-redsoil/Kconfig.defconfig
```kconfig
# Accelerando Redsoil (with eByte E73-2G4M08S1C nrf52840 System-on-module) configuration

if BOARD_ACCELERANDO_REDSOIL

config BOARD
	default "accelerando_redsoil"

if USB

config USB_NRFX
	default y

config USB_DEVICE_STACK
	default y

endif # USB

config IEEE802154_NRF5
	default y
	depends on IEEE802154

config I2C
	default y

config BT_CTLR
	default BT

endif # BOARD_ACCELERANDO_REDSOIL
```

## zephyr/boards/arm/accelerando_redsoil/Kconfig
```kconfig
# Accelerando Redsoil board configuration

config BOARD_ENABLE_DCDC
	bool "Enable DCDC mode"
	select SOC_DCDC_NRF52X
	default y
	depends on BOARD_ACCELERANDO_REDSOIL
```
